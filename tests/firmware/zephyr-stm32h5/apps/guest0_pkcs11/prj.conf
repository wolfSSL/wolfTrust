## CMakeLists.txt
```
cmake_minimum_required(VERSION 3.20.0)

find_package(Zephyr REQUIRED HINTS $ENV{ZEPHYR_BASE})
project(wolftrust_guest0_pkcs11)

if(NOT DEFINED WOLFTRUST_CMSE_IMPLIB)
  message(FATAL_ERROR "WOLFTRUST_CMSE_IMPLIB must point at build/secure_cmse_implib.o")
endif()

set(WT_REPO_ROOT ${CMAKE_CURRENT_LIST_DIR}/../../../../..)
include(${WT_REPO_ROOT}/tools/cmake/CryptoProfile.cmake)
set(WT_PROFILE_DIR ${CMAKE_CURRENT_BINARY_DIR}/crypto-profile)
wt_crypto_profile(${WT_REPO_ROOT} ${WT_PROFILE_DIR})
target_compile_options(app PRIVATE -include ${WT_PROFILE_DIR}/selected_profile.h)
set(WT_TEST_DIR ${WT_REPO_ROOT}/tests/firmware/stm32h563-tpm/freertos-pkcs11)

target_sources(app PRIVATE
  src/main.c
  ${WT_TEST_DIR}/pkcs11_tests.c
  ${WT_REPO_ROOT}/src/client/psa_ffm_client.c
  ${WT_REPO_ROOT}/src/client/pkcs11_psa_transport.c
  ${WT_REPO_ROOT}/src/client/pkcs11_proxy.c
  ${WT_REPO_ROOT}/src/pkcs11/pkcs11_wire.c
  ${WOLFTRUST_CMSE_IMPLIB}
)

target_include_directories(app PRIVATE
  ${CMAKE_CURRENT_LIST_DIR}
  ${WT_REPO_ROOT}/include
  ${WT_REPO_ROOT}/lib/wolfPKCS11
  ${WT_TEST_DIR}
)

if(NOT DEFINED WT_PKCS11_SUITE)
  if(WT_CRYPTO_PROFILE STREQUAL "default")
    set(WT_PKCS11_SUITE profile)
  else()
    set(WT_PKCS11_SUITE all)
  endif()
endif()

if(WT_PKCS11_SUITE STREQUAL "profile")
  set(WT_PKCS11_SUITE_DEF WT_PKCS11_SUITE_PROFILE)
elseif(WT_PKCS11_SUITE STREQUAL "core")
  set(WT_PKCS11_SUITE_DEF WT_PKCS11_SUITE_CORE)
elseif(WT_PKCS11_SUITE STREQUAL "objects")
  set(WT_PKCS11_SUITE_DEF WT_PKCS11_SUITE_OBJECTS)
elseif(WT_PKCS11_SUITE STREQUAL "crypto")
  set(WT_PKCS11_SUITE_DEF WT_PKCS11_SUITE_CRYPTO)
elseif(WT_PKCS11_SUITE STREQUAL "negative")
  set(WT_PKCS11_SUITE_DEF WT_PKCS11_SUITE_NEGATIVE)
elseif(WT_PKCS11_SUITE STREQUAL "all")
  set(WT_PKCS11_SUITE_DEF WT_PKCS11_SUITE_ALL)
else()
  message(FATAL_ERROR "WT_PKCS11_SUITE must be profile, core, objects, crypto, negative, or all")
endif()

target_compile_definitions(app PRIVATE
  WOLFPKCS11_USER_SETTINGS
  WOLFPKCS11_NO_ENV
  ${WT_PKCS11_SUITE_DEF}=1
  WT_PKCS11_APP_NAME="pkcs11-zephyr"
)

if(WT_M33MU_EXPECT_BKPT)
  target_compile_definitions(app PRIVATE WT_M33MU_EXPECT_BKPT=1)
endif()
```

## prj.conf
```kconfig
CONFIG_BUILD_WITH_TFM=n
CONFIG_CONSOLE=y
CONFIG_LOG=n
CONFIG_MAIN_STACK_SIZE=16384
CONFIG_PRINTK=y
CONFIG_SERIAL=y
CONFIG_TRUSTED_EXECUTION_NONSECURE=y
CONFIG_UART_CONSOLE=y
CONFIG_WOLFTRUST_ZEPHYR=n
CONFIG_WOLFTRUST_WOLFHSM_CLIENT=n
CONFIG_WOLFTRUST_NATIVE_CLIENT=n
```

## app.overlay
```dts
/ {
	wolftrust_tee0: wolftrust-tee {
		compatible = "wolfssl,wolftrust-tee";
		label = "WOLFTRUST_TEE_0";
		wolftrust-guest-slot = <0>;
		status = "okay";
	};
};

/* The PKCS#11 manifest grants guest 0 128 KiB; the provider starts at 0x080C0000. */
&slot0_ns_partition {
	reg = <0x000a0000 DT_SIZE_K(128)>;
};
```

## src/main.c
```c
/*
 * Copyright (C) 2026 wolfSSL Inc.
 *
 * This file is part of wolfTrust.
 *
 * wolfTrust is free software; you can redistribute it and/or modify
 * it under the terms of the GNU General Public License as published by
 * the Free Software Foundation; either version 3 of the License, or
 * (at your option) any later version.
 */

#include <zephyr/kernel.h>
#include <zephyr/sys/printk.h>

#include "pkcs11_tests.h"

void wt_pkcs11_puts(const char *text)
{
    printk("%s", text);
}

void wt_pkcs11_print_u32(unsigned int value)
{
    printk("%u", value);
}

void wt_pkcs11_wait(void)
{
    k_msleep(1);
}

int main(void)
{
    int rc;

    printk("pkcs11-zephyr: alive\r\n");
    rc = wt_pkcs11_run();
    if (rc == 0) {
        printk("pkcs11-zephyr: suite %s complete\r\n",
               wt_pkcs11_suite_name());
#if defined(WT_M33MU_EXPECT_BKPT) && (WT_M33MU_EXPECT_BKPT == 1)
        __asm volatile("bkpt 0x7f");
#endif
    }
    else {
        printk("pkcs11-zephyr: suite failed\r\n");
#if defined(WT_M33MU_EXPECT_BKPT) && (WT_M33MU_EXPECT_BKPT == 1)
        __asm volatile("bkpt 0x7e");
#endif
    }
    return rc;
}
```
