## CMakeLists.txt
```
cmake_minimum_required(VERSION 3.20.0)

find_package(Zephyr REQUIRED HINTS $ENV{ZEPHYR_BASE})
project(wolftrust_guest0_tpm)

if(NOT DEFINED WOLFTRUST_CMSE_IMPLIB)
  message(FATAL_ERROR "WOLFTRUST_CMSE_IMPLIB must point at build/secure_cmse_implib.o")
endif()

set(WT_REPO_ROOT ${CMAKE_CURRENT_LIST_DIR}/../../../../..)
include(${WT_REPO_ROOT}/tools/cmake/CryptoProfile.cmake)
set(WT_PROFILE_DIR ${CMAKE_CURRENT_BINARY_DIR}/crypto-profile)
wt_crypto_profile(${WT_REPO_ROOT} ${WT_PROFILE_DIR})
target_compile_options(app PRIVATE -include ${WT_PROFILE_DIR}/selected_profile.h)
set(WT_WOLFTPM_DIR ${WT_REPO_ROOT}/lib/wolfTPM)
set(WT_TEST_DIR ${WT_REPO_ROOT}/tests/firmware/stm32h563-tpm/tpm-app)

set(WT_WOLFTPM_SOURCES
  ${WT_WOLFTPM_DIR}/src/tpm2.c
  ${WT_WOLFTPM_DIR}/src/tpm2_util.c
  ${WT_WOLFTPM_DIR}/src/tpm2_packet.c
  ${WT_WOLFTPM_DIR}/src/tpm2_wrap.c
  ${WT_WOLFTPM_DIR}/src/tpm2_asn.c
  ${WT_WOLFTPM_DIR}/src/tpm2_crypto.c
  ${WT_WOLFTPM_DIR}/src/tpm2_param_enc.c
  ${WT_WOLFTPM_DIR}/src/tpm2_cryptocb.c
)

target_sources(app PRIVATE
  src/main.c
  ${WT_TEST_DIR}/tpm_tests.c
  ${WT_REPO_ROOT}/src/client/tpm_psa_transport.c
  ${WT_WOLFTPM_SOURCES}
  ${WOLFTRUST_CMSE_IMPLIB}
)

target_include_directories(app PRIVATE
  ${WT_REPO_ROOT}/include
  ${WT_WOLFTPM_DIR}
  ${WT_TEST_DIR}
)

target_compile_definitions(app PRIVATE
  WOLFTPM_USER_SETTINGS
  WOLFTPM_ZEPHYR
  WOLFTPM_SWTPM
  WOLFTPM_SMALL_STACK
  WT_TPM_APP_NAME="tpm-zephyr"
)

if(WT_M33MU_EXPECT_BKPT)
  target_compile_definitions(app PRIVATE WT_M33MU_EXPECT_BKPT=1)
endif()

set_source_files_properties(
  ${WT_WOLFTPM_SOURCES}
  PROPERTIES COMPILE_OPTIONS
    "-Wno-unused-function;-Wno-unused-variable;-Wno-unused-parameter;-Wno-type-limits"
)
```

## prj.conf
```kconfig
CONFIG_BUILD_WITH_TFM=n
CONFIG_COMMON_LIBC_MALLOC_ARENA_SIZE=16384
CONFIG_CONSOLE=y
CONFIG_LOG=n
CONFIG_MAIN_STACK_SIZE=24576
CONFIG_PRINTK=y
CONFIG_SERIAL=y
CONFIG_TRUSTED_EXECUTION_NONSECURE=y
CONFIG_UART_CONSOLE=y
CONFIG_WOLFTRUST_ZEPHYR=n
CONFIG_WOLFTRUST_WOLFHSM_CLIENT=n
CONFIG_WOLFTRUST_NATIVE_CLIENT=y
```

## app.overlay
```dts
/ {
	wolftrust_tee0: wolftrust-tee {
		compatible = "wolfssl,wolftrust-tee";
		label = "WOLFTRUST_TEE_0";
		wolftrust-guest-slot = <0>;
		status = "okay";
	};
};
```

## src/main.c
```c
/*
 * Copyright (C) 2026 wolfSSL Inc.
 *
 * This file is part of wolfTrust.
 *
 * wolfTrust is free software; you can redistribute it and/or modify
 * it under the terms of the GNU General Public License as published by
 * the Free Software Foundation; either version 3 of the License, or
 * (at your option) any later version.
 */

#include <zephyr/kernel.h>
#include <zephyr/sys/printk.h>

#include "tpm_tests.h"

void wt_tpm_puts(const char *text)
{
    printk("%s", text);
}

void wt_tpm_print_i32(int value)
{
    printk("%d", value);
}

void wt_tpm_wait(void)
{
    k_msleep(1);
}

int main(void)
{
    int rc;

    printk("tpm-zephyr: alive\r\n");
    rc = wt_tpm_run();
    if (rc == 0) {
        printk("tpm-zephyr: suite complete\r\n");
#if defined(WT_M33MU_EXPECT_BKPT) && (WT_M33MU_EXPECT_BKPT == 1)
        __asm volatile("bkpt 0x7f");
#endif
    }
    else {
        printk("tpm-zephyr: suite failed\r\n");
#if defined(WT_M33MU_EXPECT_BKPT) && (WT_M33MU_EXPECT_BKPT == 1)
        __asm volatile("bkpt 0x7e");
#endif
    }
    return rc;
}
```
