## tests/firmware/zephyr-stm32h5/module/wolfpsa/Kconfig
```kconfig
menuconfig WOLFPSA
	bool "wolfPSA Crypto engine (PSA API over wolfCrypt)"
	depends on WOLFTRUST_WOLFHSM_CLIENT || WOLFTRUST_NATIVE_CLIENT
	depends on !MBEDTLS
	depends on !BUILD_WITH_TFM
	help
	  Link the lib/wolfPSA submodule into the Zephyr image and expose
	  the PSA Crypto API on top of wolfCrypt. With the wolfhsm-client
	  module (hsm engine) the glue calls wolfPSA_SetDefaultDevID(WH_DEV_ID)
	  in its SYS_INIT hook so every psa_*() call routes through the wolfHSM
	  client across the CMSE boundary; with the native client, primitives
	  run Non-secure and only DRBG seeds cross to the secure vault RNG.
	  Mutually exclusive with Zephyr's bundled mbedTLS PSA front-end
	  and TF-M.

config WOLFTRUST_SECURE_PSA
	bool "PSA Crypto served by the wolfTrust Secure image (WT_SECURE_PSA=1)"
	depends on WOLFPSA && WOLFTRUST_NATIVE_CLIENT
	default y
	help
	  Link the wolfTrust PSA Crypto client in place of wolfPSA: every
	  psa_*() call crosses SERVICE_HSM to wolfPSA in the Secure image, and
	  keys and operation state never enter Non-secure memory. This is the
	  native default; say n only for a Secure image built WT_SECURE_PSA=0.
```
